## conf/layer.conf
```bitbake
# We have a conf and classes directory, add to BBPATH
BBPATH .= ":${LAYERDIR}"

# We have recipes-* directories, add to BBFILES
BBFILES += "${LAYERDIR}/recipes-*/*/*.bb \
            ${LAYERDIR}/recipes-*/*/*.bbappend"

BBFILE_COLLECTIONS += "setuptools-backport"
BBFILE_PATTERN_setuptools-backport = "^${LAYERDIR}/"
BBFILE_PRIORITY_setuptools-backport = "10"
LAYERVERSION_setuptools-backport = "4"
LAYERSERIES_COMPAT_setuptools-backport = "dunfell"
```
